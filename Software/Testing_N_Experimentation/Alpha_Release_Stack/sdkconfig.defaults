## Software/Testing_N_Experimentation/Alpha_Release_Stack/sdkconfig.defaults
```kconfig
# Synth-Head GPU SDK Configuration
# Disables task watchdog for main loop flexibility

# Disable task watchdog
CONFIG_ESP_TASK_WDT_EN=n

# Flash size
CONFIG_ESPTOOLPY_FLASHSIZE_8MB=y
CONFIG_PARTITION_TABLE_CUSTOM=n
# Disable mbedTLS certificate bundle (fixes PlatformIO/ESP-IDF 5.5.0 build issue)
CONFIG_MBEDTLS_CERTIFICATE_BUNDLE=n
CONFIG_MBEDTLS_CERTIFICATE_BUNDLE_DEFAULT_FULL=n
CONFIG_MBEDTLS_CERTIFICATE_BUNDLE_DEFAULT_CMN=n
```

## Software/Testing_N_Experimentation/Alpha_Release_Stack/sdkconfig.defaults.CPU
```kconfig
# Synth-Head CPU SDK Configuration (16MB Flash)
# For ESP32-S3-WROOM-1U-N16

# Disable task watchdog
CONFIG_ESP_TASK_WDT_EN=n

# Increase main task stack size for heavy boot sequence
CONFIG_ESP_MAIN_TASK_STACK_SIZE=8192

# Flash size - 16MB
CONFIG_ESPTOOLPY_FLASHSIZE_16MB=y
CONFIG_ESPTOOLPY_FLASHSIZE="16MB"

# Custom partition table
CONFIG_PARTITION_TABLE_CUSTOM=y
CONFIG_PARTITION_TABLE_CUSTOM_FILENAME="partitions_16MB.csv"
CONFIG_PARTITION_TABLE_FILENAME="partitions_16MB.csv"

# FAT Filesystem - Enable Long Filename support
# CRITICAL: Must explicitly disable LFN_NONE to enable long filenames
CONFIG_FATFS_LFN_NONE=n
CONFIG_FATFS_LFN_HEAP=y
CONFIG_FATFS_MAX_LFN=255
```

## Software/Testing_N_Experimentation/Alpha_Release_Stack/sdkconfig.defaults.GPU
```kconfig
# GPU-specific sdkconfig overrides
# Disable brownout detector - HUB75 panels cause voltage drops during GPIO init
CONFIG_ESP_BROWNOUT_DET=n
CONFIG_BROWNOUT_DET=n
CONFIG_ESP32S3_BROWNOUT_DET=n

# HUB75 Display Configuration
# Reduce colour depth to fit DMA buffers in ESP32-S3 memory
# Default colour_depth=5 needs ~148KB DMA buffer which exceeds available
# colour_depth=3 needs ~89KB which fits comfortably
# Note: This must be configured via code, not sdkconfig
# (Included here for documentation purposes)
```

## Software/Testing_N_Experimentation/Alpha_Release_Stack/sdkconfig.defaults.OledTest
```kconfig
# OLED Test SDK Config - Minimal build, no TLS/HTTPS needed
CONFIG_MBEDTLS_CERTIFICATE_BUNDLE=n
CONFIG_ESP_TLS_USING_MBEDTLS=y
CONFIG_MBEDTLS_CERTIFICATE_BUNDLE_DEFAULT_FULL=n
CONFIG_MBEDTLS_CERTIFICATE_BUNDLE_DEFAULT_CMN=n
```

## Software/Testing_N_Experimentation/Alpha_Release_Stack/sdkconfig.defaults.WebConfigTest
```kconfig
# sdkconfig.defaults for CPU Web Config Test
# WiFi AP + HTTP server with dynamic parameter configuration
# Copy of WifiSpriteTest settings for TLS bundle disabled

# Flash size - 8MB
CONFIG_ESPTOOLPY_FLASHSIZE_8MB=y
CONFIG_ESPTOOLPY_FLASHSIZE="8MB"

# Disable task watchdog
CONFIG_ESP_TASK_WDT_EN=n

# CRITICAL: Disable HTTPS/TLS certificate bundle (not needed for HTTP-only captive portal)
CONFIG_MBEDTLS_CERTIFICATE_BUNDLE=n

# Compiler optimization (use -Os to avoid GCC bugs)
CONFIG_COMPILER_OPTIMIZATION_SIZE=y

# WiFi configuration
CONFIG_ESP_WIFI_ENABLED=y

# HTTP server settings
CONFIG_HTTPD_MAX_REQ_HDR_LEN=2048
CONFIG_HTTPD_MAX_URI_LEN=512
```

## Software/Testing_N_Experimentation/Alpha_Release_Stack/sdkconfig.defaults.WifiSpriteTest
```kconfig
# sdkconfig.defaults for WiFi Sprite Upload Test
# Minimal config for WiFi AP + HTTP server + GPU driver

# Disable task watchdog
CONFIG_ESP_TASK_WDT_EN=n

# Flash size - 8MB
CONFIG_ESPTOOLPY_FLASHSIZE_8MB=y
CONFIG_ESPTOOLPY_FLASHSIZE="8MB"

# Disable HTTPS/TLS certificate bundle (not needed for HTTP-only captive portal)
CONFIG_MBEDTLS_CERTIFICATE_BUNDLE=n
CONFIG_MBEDTLS_CERTIFICATE_BUNDLE_DEFAULT_NONE=y

# Compiler optimization (use -Os to avoid GCC bugs)
CONFIG_COMPILER_OPTIMIZATION_SIZE=y

# WiFi configuration
CONFIG_ESP_WIFI_ENABLED=y

# HTTP server settings
CONFIG_HTTPD_MAX_REQ_HDR_LEN=1024
CONFIG_HTTPD_MAX_URI_LEN=512
```
